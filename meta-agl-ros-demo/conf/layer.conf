## meta-agl-ros-demo/conf/layer.conf
```bitbake
# We have a conf and classes directory, add to BBPATH
BBPATH .= ":${LAYERDIR}"

# We have recipes-* directories, add to BBFILES
BBFILES += "${LAYERDIR}/recipes-*/*/*.bb \
            ${LAYERDIR}/recipes-*/*/*.bbappend"

BBFILE_COLLECTIONS += "meta-agl-ros-demo"
BBFILE_PATTERN_meta-agl-ros-demo = "^${LAYERDIR}/"
BBFILE_PRIORITY_meta-agl-ros-demo = "6"

LAYERDEPENDS_meta-agl-ros-demo = "core ros2-humble-layer"
LAYERSERIES_COMPAT_meta-agl-ros-demo = "scarthgap"
```
